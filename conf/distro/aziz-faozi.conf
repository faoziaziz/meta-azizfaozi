## conf/layer.conf
```bitbake
# We have a conf and classes directory, add to BBPATH
BBPATH .= ":${LAYERDIR}"

# We have recipes-* directories, add to BBFILES
BBFILES += "${LAYERDIR}/recipes-*/*/*.bb \
            ${LAYERDIR}/recipes-*/*/*.bbappend"

BBFILE_COLLECTIONS += "meta-azizfaozi"
BBFILE_PATTERN_meta-azizfaozi = "^${LAYERDIR}/"
BBFILE_PRIORITY_meta-azizfaozi = "6"

LAYERDEPENDS_meta-azizfaozi = "core"
LAYERSERIES_COMPAT_meta-azizfaozi = "gatesgarth"
```
